## src/ch32v30x/Kconfig
```kconfig
# Kconfig settings for WCH CH32V30x processor

if MACH_CH32V30x

config CH32V30x_SELECT
    bool
    default y
    select HAVE_GPIO
    select HAVE_GPIO_ADC
    select HAVE_GPIO_BITBANGING
    select HAVE_STRICT_TIMING
    select HAVE_GPIO_HARD_PWM
    select HAVE_STEPPER_BOTH_EDGE

config BOARD_DIRECTORY
    string
    default "ch32v30x"


######################################################################
# Communication interface
######################################################################

choice
    prompt "Communication interface"
    config CH32V30x_SERIAL_PA9_PA10
        bool "Serial (PA9 & PA10) - CH32V307EVT"
        select SERIAL
    # todo: usb fs and hs support
endchoice


######################################################################
# Bootloader
# bootloader moves code and then VTOR.RESET points here:
# todo: no bootloader support yet
######################################################################
# We use 192K flash + 128K sram
config FLASH_SIZE
    hex
    default 0x30000

config FLASH_APPLICATION_ADDRESS
    default 0x8000 

config FLASH_BOOT_ADDRESS
    hex
    default 0x0

config RAM_SIZE
    hex
    default 0x20000

config RAM_START
    hex
    default 0x20000000

config STACK_SIZE
    int
    default 2048

# use 144M as default
config CLOCK_FREQ
    int
    default 144000000


config MCU
    string
    default "CH32V30x"

endif
```
